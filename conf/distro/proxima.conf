## conf/distro/proxima.conf
```bitbake
DISTRO_NAME="proxima"
DISTRO_VERSION="0.9"

# Enable systemd and other features
DISTRO_FEATURES += " systemd opengl vulkan ipv6 seccomp"

# Use systemd as the init system
VIRTUAL-RUNTIME_init_manager = "systemd"
VIRTUAL-RUNTIME_initscripts = "systemd-compat-units"

# Use TI's kernel 6.12 for GPU hardware acceleration support
# Note: Kernel version selection is now done in the machine configuration file
# (e.g., conf/machine/warp-am62x.conf) to avoid multi-config issues with k3r5
PREFERRED_PROVIDER_virtual/kernel = "linux-ti-staging"
# Select kernel version - change to 6.12% if needed
PREFERRED_VERSION_linux-ti-staging = "6.18%"

# Select GPU driver version matching kernel version
# For kernel 6.18: use 25.3.6908880
# For kernel 6.12: use 25.2.6850647
PREFERRED_VERSION_ti-img-rogue-driver = "25.3.6908880"
PREFERRED_VERSION_ti-img-rogue-umlibs = "25.3.6908880"

# Use mesa-pvr as the OpenGL provider for TI GPU support
PREFERRED_PROVIDER_virtual/libgl = "mesa-pvr"
PREFERRED_PROVIDER_virtual/libgles1 = "mesa-pvr"
PREFERRED_PROVIDER_virtual/libgles2 = "mesa-pvr"
PREFERRED_PROVIDER_virtual/libgles3 = "mesa-pvr"
PREFERRED_PROVIDER_virtual/egl = "mesa-pvr"
PREFERRED_PROVIDER_virtual/mesa = "mesa-pvr"
PREFERRED_PROVIDER_virtual/gpudriver = "ti-img-rogue-driver"
```
